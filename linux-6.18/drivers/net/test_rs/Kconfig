## linux-6.18/drivers/net/test_rs/Kconfig
```kconfig
config TEST_RS
	tristate "Test Rust module"
	depends on RUST
	help
	  This enables a dummy Rust kernel module for testing.

	  If unsure, say N.
```

## linux-6.18/drivers/net/wireguard_rs/Kconfig
```kconfig
config WIREGUARD_RS
	tristate "Wireguard Rust experimental module"
	depends on RUST
	help
	  Experimental Rust implementation of the Wireguard protocol
```
